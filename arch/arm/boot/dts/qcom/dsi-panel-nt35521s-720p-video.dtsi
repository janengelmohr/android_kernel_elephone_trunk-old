/**********uniscope-driver-modify-file-on-qualcomm-platform*****************/
/* Copyright (c) 2013, The Linux Foundation. All rights reserved.
 *
 * This program is free software; you can redistribute it and/or modify
 * it under the terms of the GNU General Public License version 2 and
 * only version 2 as published by the Free Software Foundation.
 *
 * This program is distributed in the hope that it will be useful,
 * but WITHOUT ANY WARRANTY; without even the implied warranty of
 * MERCHANTABILITY or FITNESS FOR A PARTICULAR PURPOSE.  See the
 * GNU General Public License for more details.
 */

/*---------------------------------------------------------------------------
 * This file is autogenerated file using gcdb parser. Please do not edit it.
 * Update input XML file to add a new entry or update variable in this file
 * VERSION = "1.0"
 *---------------------------------------------------------------------------*/
&mdss_mdp {
	dsi_nt35521s_720p_video: qcom,mdss_dsi_nt35521s_720p_video {
		qcom,mdss-dsi-panel-name = "nt35521s 720p video mode dsi panel";
		qcom,mdss-dsi-panel-controller = <&mdss_dsi0>;
		qcom,mdss-dsi-panel-type = "dsi_video_mode";
		qcom,mdss-dsi-panel-destination = "display_1";
		qcom,mdss-dsi-panel-framerate = <60>;
		qcom,mdss-dsi-virtual-channel-id = <0>;
		qcom,mdss-dsi-stream = <0>;
		qcom,mdss-dsi-panel-width = <720>;
		qcom,mdss-dsi-panel-height = <1280>;
		qcom,mdss-dsi-h-front-porch = <70>;
		qcom,mdss-dsi-h-back-porch = <70>;
		qcom,mdss-dsi-h-pulse-width = <26>;
		qcom,mdss-dsi-h-sync-skew = <0>;
		qcom,mdss-dsi-v-back-porch = <12>;
		qcom,mdss-dsi-v-front-porch = <15>;
		qcom,mdss-dsi-v-pulse-width = <4>;
		qcom,mdss-dsi-h-left-border = <0>;
		qcom,mdss-dsi-h-right-border = <0>;
		qcom,mdss-dsi-v-top-border = <0>;
		qcom,mdss-dsi-v-bottom-border = <0>;
		qcom,mdss-dsi-bpp = <24>;
		qcom,mdss-dsi-color-order = "rgb_swap_rgb";
		qcom,mdss-dsi-underflow-color = <0xff>;
		qcom,mdss-dsi-border-color = <0>;
		qcom,mdss-dsi-on-command = [29 01 00 00 00 00 06 F0 55 AA 52 08 00
					29 01 00 00 00 00 05 FF AA 55 A5 80
					29 01 00 00 00 00 02 6F 13
					29 01 00 00 00 00 02 F7 00
					29 01 00 00 00 00 02 6F 01
					29 01 00 00 00 00 02 B1 21
					29 01 00 00 00 00 02 6F 02
					29 01 00 00 00 00 02 B8 0C
					29 01 00 00 00 00 03 BB 11 11
					29 01 00 00 00 00 03 BC 00 00
					29 01 00 00 00 00 02 B6 0F
					29 01 00 00 00 00 02 C8 80
					29 01 00 00 00 00 06 F0 55 AA 52 08 01
					29 01 00 00 00 00 03 B0 09 09
					29 01 00 00 00 00 03 B1 09 09
					29 01 00 00 00 00 03 BC A0 00
					29 01 00 00 00 00 03 BD A0 00
					29 01 00 00 00 00 02 CA 00
					29 01 00 00 00 00 02 C0 04
					29 01 00 00 00 00 03 B5 03 03
					29 01 00 00 00 00 02 BE 8d
					29 01 00 00 00 00 03 B3 28 28
					29 01 00 00 00 00 03 B4 0F 0F
					29 01 00 00 00 00 03 B9 35 35
					29 01 00 00 00 00 03 BA 14 14
					29 01 00 00 00 00 06 F0 55 AA 52 08 02
					29 01 00 00 00 00 02 EE 01
					29 01 00 00 00 00 11 B0 00 00 00 0B 00 34 00 47 00 52 00 72 00 93 00 DD
					29 01 00 00 00 00 11 B1 00 FA 01 30 01 62 01 B2 01 F6 01 F8 02 2F 02 70
					29 01 00 00 00 00 11 B2 02 9C 02 D3 02 FD 03 37 03 6E 03 C5 03 DF 03 F0
					29 01 00 00 00 00 05 B3 03 FD 03 FF
					29 01 00 00 00 00 06 F0 55 AA 52 08 06
					29 01 00 00 00 00 03 B0 2D 2E
					29 01 00 00 00 00 03 B1 29 2A
					29 01 00 00 00 00 03 B2 16 18
					29 01 00 00 00 00 03 B3 10 12
					29 01 00 00 00 00 03 B4 00 02
					29 01 00 00 00 00 03 B5 31 31
					29 01 00 00 00 00 03 B6 31 31
					29 01 00 00 00 00 03 B7 31 31
					29 01 00 00 00 00 03 B8 31 31
					29 01 00 00 00 00 03 B9 31 31
					29 01 00 00 00 00 03 BA 31 31
					29 01 00 00 00 00 03 BB 31 31
					29 01 00 00 00 00 03 BC 31 31
					29 01 00 00 00 00 03 BD 31 31
					29 01 00 00 00 00 03 BE 31 31
					29 01 00 00 00 00 03 BF 03 01
					29 01 00 00 00 00 03 C0 13 11
					29 01 00 00 00 00 03 C1 19 17
					29 01 00 00 00 00 03 C2 2A 29
					29 01 00 00 00 00 03 C3 2E 2D
					29 01 00 00 00 00 03 E5 31 31
					29 01 00 00 00 00 03 C4 2E 2D
					29 01 00 00 00 00 03 C5 29 2A
					29 01 00 00 00 00 03 C6 13 11
					29 01 00 00 00 00 03 C7 19 17
					29 01 00 00 00 00 03 C8 03 01
					29 01 00 00 00 00 03 C9 31 31
					29 01 00 00 00 00 03 CA 31 31
					29 01 00 00 00 00 03 CB 31 31
					29 01 00 00 00 00 03 CC 31 31
					29 01 00 00 00 00 03 CD 31 31
					29 01 00 00 00 00 03 CE 31 31
					29 01 00 00 00 00 03 CF 31 31
					29 01 00 00 00 00 03 D0 31 31
					29 01 00 00 00 00 03 D1 31 31
					29 01 00 00 00 00 03 D2 31 31
					29 01 00 00 00 00 03 D3 00 02
					29 01 00 00 00 00 03 D4 16 18
					29 01 00 00 00 00 03 D5 10 12
					29 01 00 00 00 00 03 D6 2A 29
					29 01 00 00 00 00 03 D7 2D 2E
					29 01 00 00 00 00 03 E6 31 31
					29 01 00 00 00 00 06 D8 00 00 00 00 00
					29 01 00 00 00 00 06 D9 00 00 00 00 00
					29 01 00 00 00 00 02 E7 00
					29 01 00 00 00 00 06 F0 55 AA 52 08 05
					29 01 00 00 00 00 02 ED 30
					29 01 00 00 00 00 06 F0 55 AA 52 08 03
					29 01 00 00 00 00 03 B1 20 00
					29 01 00 00 00 00 03 B0 20 00
					29 01 00 00 00 00 06 F0 55 AA 52 08 05
					29 01 00 00 00 00 02 E5 00
					29 01 00 00 00 00 06 F0 55 AA 52 08 05
					29 01 00 00 00 00 03 B0 17 06
					29 01 00 00 00 00 02 B8 00
					29 01 00 00 00 00 06 BD 03 03 00 03 03
					29 01 00 00 00 00 03 B1 17 06
					29 01 00 00 00 00 03 B9 00 03
					29 01 00 00 00 00 03 B2 17 06
					29 01 00 00 00 00 03 BA 00 00
					29 01 00 00 00 00 03 B3 17 06
					29 01 00 00 00 00 03 BB 02 03
					29 01 00 00 00 00 03 B4 17 06
					29 01 00 00 00 00 03 B5 17 06
					29 01 00 00 00 00 03 B6 17 06
					29 01 00 00 00 00 03 B7 17 06
					29 01 00 00 00 00 03 BC 02 03
					29 01 00 00 00 00 02 E5 06
					29 01 00 00 00 00 02 E6 06
					29 01 00 00 00 00 02 E7 00
					29 01 00 00 00 00 02 E8 06
					29 01 00 00 00 00 02 E9 06
					29 01 00 00 00 00 02 EA 06
					29 01 00 00 00 00 02 EB 00
					29 01 00 00 00 00 02 EC 00
					29 01 00 00 00 00 06 F0 55 AA 52 08 05
					29 01 00 00 00 00 02 C0 0B
					29 01 00 00 00 00 02 C1 09
					29 01 00 00 00 00 02 C2 A6
					29 01 00 00 00 00 02 C3 05
					29 01 00 00 00 00 06 F0 55 AA 52 08 03
					29 01 00 00 00 00 06 B2 05 00 4B 00 00
					29 01 00 00 00 00 06 B3 05 00 4B 00 00
					29 01 00 00 00 00 06 B4 05 00 17 00 00
					29 01 00 00 00 00 06 B5 05 00 17 00 00
					29 01 00 00 00 00 06 F0 55 AA 52 08 05
					29 01 00 00 00 00 02 C4 00
					29 01 00 00 00 00 02 C5 02
					29 01 00 00 00 00 02 C6 22
					29 01 00 00 00 00 02 C7 03
					29 01 00 00 00 00 06 F0 55 AA 52 08 03
					29 01 00 00 00 00 06 B6 02 00 19 00 00
					29 01 00 00 00 00 06 B7 02 00 19 00 00
					29 01 00 00 00 00 06 B8 02 00 19 00 00
					29 01 00 00 00 00 06 B9 02 00 19 00 00
					29 01 00 00 00 00 06 F0 55 AA 52 08 05
					29 01 00 00 00 00 03 C8 07 20
					29 01 00 00 00 00 03 C9 03 20
					29 01 00 00 00 00 03 CA 01 60
					29 01 00 00 00 00 03 CB 01 60
					29 01 00 00 00 00 06 F0 55 AA 52 08 03
					29 01 00 00 00 00 06 BA 53 00 4B 00 00
					29 01 00 00 00 00 06 BB 53 00 4B 00 00
					29 01 00 00 00 00 06 BC 53 00 1A 00 00
					29 01 00 00 00 00 06 BD 53 00 1A 00 00
					29 01 00 00 00 00 06 F0 55 AA 52 08 05
					29 01 00 00 00 00 06 D1 00 05 01 07 10
					29 01 00 00 00 00 06 D2 10 05 05 03 10
					29 01 00 00 00 00 06 D3 20 00 43 07 10
					29 01 00 00 00 00 06 D4 30 00 43 07 10
					29 01 00 00 00 00 06 F0 55 AA 52 08 05
					29 01 00 00 00 00 08 D0 00 00 00 00 00 00 00
					29 01 00 00 00 00 0C D5 00 00 00 00 00 00 00 00 00 00 00
					29 01 00 00 00 00 0C D6 00 00 00 00 00 00 00 00 00 00 00
					29 01 00 00 00 00 0C D7 00 00 00 00 00 00 00 00 00 00 00
					29 01 00 00 00 00 06 D8 00 00 00 00 00
					29 01 00 00 00 00 06 F0 55 AA 52 08 05
					29 01 00 00 00 00 04 CC 00 00 01
					29 01 00 00 00 00 04 CD 00 00 01
					29 01 00 00 00 00 04 CE 00 00 02
					29 01 00 00 00 00 04 CF 00 00 02
					29 01 00 00 00 00 06 F0 55 AA 52 08 03
					29 01 00 00 00 00 05 C0 00 34 00 00
					29 01 00 00 00 00 05 C1 00 00 34 00
					29 01 00 00 00 00 05 C2 00 00 34 00
					29 01 00 00 00 00 05 C3 00 00 34 00
					29 01 00 00 00 00 06 F0 55 AA 52 08 03
					29 01 00 00 00 00 02 C4 60
					29 01 00 00 00 00 02 C5 C0
					29 01 00 00 00 00 02 C6 00
					29 01 00 00 00 00 02 C7 00
					29 01 00 00 78 00 02 11 00
					29 01 00 00 78 00 02 29 00];
		qcom,mdss-dsi-off-command = [05 01 00 00 32 00 02 28 00
					05 01 00 00 78 00 02 10 00];
		qcom,mdss-dsi-on-command-state = "dsi_lp_mode";
		qcom,mdss-dsi-off-command-state = "dsi_hs_mode";
		qcom,mdss-dsi-h-sync-pulse = <1>;
		qcom,mdss-dsi-traffic-mode = "burst_mode";
		qcom,mdss-dsi-lane-map = "lane_map_0123";
		qcom,mdss-dsi-bllp-eof-power-mode;
		qcom,mdss-dsi-lane-0-state;
		qcom,mdss-dsi-lane-1-state;
		qcom,mdss-dsi-lane-2-state;
		qcom,mdss-dsi-lane-3-state;
		qcom,mdss-dsi-panel-timings = [BB  1A  10  00  3E  40  16  1E  15  03  04  00];
		qcom,mdss-dsi-t-clk-post = <0x20>;
		qcom,mdss-dsi-t-clk-pre = <0x2f>;
		qcom,mdss-dsi-bl-min-level = <1>;
		qcom,mdss-dsi-bl-max-level = <4095>;
		qcom,mdss-dsi-dma-trigger = "trigger_sw";
		qcom,mdss-dsi-mdp-trigger = "none";
		qcom,mdss-dsi-bl-pmic-control-type = "bl_ctrl_wled";
		qcom,mdss-dsi-reset-sequence = <1 20>, <0 2>, <1 20>;
	};
};
