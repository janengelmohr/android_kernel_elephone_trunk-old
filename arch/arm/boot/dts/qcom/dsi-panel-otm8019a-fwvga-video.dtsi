/**********uniscope-driver-modify-file-on-qualcomm-platform*****************/
/* Copyright (c) 2013, The Linux Foundation. All rights reserved.
 *
 * This program is free software; you can redistribute it and/or modify
 * it under the terms of the GNU General Public License version 2 and
 * only version 2 as published by the Free Software Foundation.
 *
 * This program is distributed in the hope that it will be useful,
 * but WITHOUT ANY WARRANTY; without even the implied warranty of
 * MERCHANTABILITY or FITNESS FOR A PARTICULAR PURPOSE.  See the
 * GNU General Public License for more details.
 */
  
/*---------------------------------------------------------------------------
 * This file is autogenerated file using gcdb parser. Please do not edit it.
 * Update input XML file to add a new entry or update variable in this file
 * VERSION = "1.0"
 *---------------------------------------------------------------------------*/
&mdss_mdp {
	dsi_otm8019a_fwvga_video: qcom,mdss_dsi_otm8019a_fwvga_video {
		qcom,mdss-dsi-panel-name = "otm8019a fwvga video mode dsi panel";
		qcom,mdss-dsi-panel-controller = <&mdss_dsi0>;
		qcom,mdss-dsi-panel-type = "dsi_video_mode";
		qcom,mdss-dsi-panel-destination = "display_1";
		qcom,mdss-dsi-panel-framerate = <60>;
		qcom,mdss-dsi-virtual-channel-id = <0>;
		qcom,mdss-dsi-stream = <0>;
		qcom,mdss-dsi-panel-width = <480>;
		qcom,mdss-dsi-panel-height = <854>;
		qcom,mdss-dsi-h-front-porch = <60>;
		qcom,mdss-dsi-h-back-porch = <60>;
		qcom,mdss-dsi-h-pulse-width = <20>;
		qcom,mdss-dsi-h-sync-skew = <0>;
		qcom,mdss-dsi-v-back-porch = <10>;
		qcom,mdss-dsi-v-front-porch = <16>;
		qcom,mdss-dsi-v-pulse-width = <4>;
		qcom,mdss-dsi-h-left-border = <0>;
		qcom,mdss-dsi-h-right-border = <0>;
		qcom,mdss-dsi-v-top-border = <0>;
		qcom,mdss-dsi-v-bottom-border = <0>;
		qcom,mdss-dsi-bpp = <24>;
		qcom,mdss-dsi-color-order = "rgb_swap_rgb";
		qcom,mdss-dsi-underflow-color = <0xff>;
		qcom,mdss-dsi-border-color = <0>;
		qcom,mdss-dsi-on-command = [29 01 00 00 00 00 02 00 00                                                                                         
		29 01 00 00 00 00 04 FF 80 19 01                                                                             
		29 01 00 00 00 00 02 00 80                                                                                         
		29 01 00 00 00 00 03 FF 80 19                                                                                   
		29 01 00 00 00 00 02 00 B4                                                                                         
		29 01 00 00 00 00 02 C0 20                                                                                         
		29 01 00 00 00 00 02 00 81                                                                                         
		29 01 00 00 00 00 02 C5 66                                                                                         
		29 01 00 00 00 00 02 00 82                                                                                         
		29 01 00 00 00 00 02 C5 B0                                                                                         
		29 01 00 00 00 00 02 00 90                                                                                         
		29 01 00 00 00 00 03 C5 4E 76                                                                                   
		29 01 00 00 00 00 02 00 00                                                                                         
		29 01 00 00 00 00 03 D8 6F 6f                                                                                   
		29 01 00 00 00 00 02 00 00                                                                                         
		29 01 00 00 00 00 02 D9 4C                                                                                         
		29 01 00 00 00 00 02 00 81                                                                                         
		29 01 00 00 00 00 02 C1 33                                                                                         
		29 01 00 00 00 00 02 00 A1                                                                                         
		29 01 00 00 00 00 02 C1 08                                                                                         
		29 01 00 00 00 00 02 00 81                                                                                         
		29 01 00 00 00 00 02 C4 83                                                                                         
		29 01 00 00 00 00 02 00 B1                                                                                         
		29 01 00 00 00 00 02 C5 A9                                                                                         
		29 01 00 00 00 00 02 00 93                                                                                         
		29 01 00 00 00 00 02 C5 03                                                                                         
		29 01 00 00 00 00 02 00 92                                                                                         
		29 01 00 00 00 00 02 B3 40                                                                                         
		29 01 00 00 00 00 02 00 90                                                                                         
		29 01 00 00 00 00 02 B3 02                                                                                         
		29 01 00 00 00 00 02 00 80                                                                                         
		29 01 00 00 00 00 0A C0 00 58 00 15 15 00 58 15 15                                         
		29 01 00 00 00 00 02 00 90                                                                                         
		29 01 00 00 00 00 07 C0 00 15 00 00 00 03                                                           
		29 01 00 00 00 00 02 00 80                                                                                         
		29 01 00 00 00 00 0D CE 8B 03 00 8A 03 00 89 03 00 88 03 00                       
		29 01 00 00 00 00 02 00 A0                                                                                         
		29 01 00 00 00 00 0F CE 38 07 03 54 00 02 00 38 06 03 55 00 02 00           
		29 01 00 00 00 00 02 00 B0                                                                                         
		29 01 00 00 00 00 0F CE 38 05 03 56 00 02 00 38 04 03 57 00 02 00           
		29 01 00 00 00 00 02 00 C0                                                                                          
		29 01 00 00 00 00 0F CE 38 03 03 58 00 02 00 38 02 03 59 00 02 00           
		29 01 00 00 00 00 02 00 D0                                                                                         
		29 01 00 00 00 00 0F CE 38 01 03 5A 00 02 00 38 00 03 5B 00 02 00           
		29 01 00 00 00 00 02 00 C0                                                                                         
		29 01 00 00 00 00 0B CF 02 02 00 00 00 00 01 00 00 00                                   
		29 01 00 00 00 00 02 00 90                                                                                         
		29 01 00 00 00 00 10 CB 00 00 00 00 00 00 00 00 00 00 00 00 00 00 00     
		29 01 00 00 00 00 02 00 A0                                                                                         
		29 01 00 00 00 00 02 CB 00                                                                                         
		29 01 00 00 00 00 02 00 A5                                                                                         
		29 01 00 00 00 00 0B CB 00 00 00 00 00 00 00 00 00 00                                   
		29 01 00 00 00 00 02 00 B0                                                                                         
		29 01 00 00 00 00 07 CB 00 00 00 00 00 00                                                           
		29 01 00 00 00 00 02 00 C0                                                                                         
		29 01 00 00 00 00 10 CB 01 01 01 01 01 01 01 01 01 01 00 00 00 00 00     
		29 01 00 00 00 00 02 00 D0                                                                                         
		29 01 00 00 00 00 02 CB 00                                                                                         
		29 01 00 00 00 00 02 00 D5                                                                                         
		29 01 00 00 00 00 0B CB 00 00 00 00 00 00 01 01 01 01                                   
		29 01 00 00 00 00 02 00 E0                                                                                         
		29 01 00 00 00 00 07 CB 01 01 01 01 01 01                                                           
		29 01 00 00 00 00 02 00 80                                                                                         
		29 01 00 00 00 00 0B CC 26 25 21 22 0C 0A 10 0E 02 04                                   
		29 01 00 00 00 00 02 00 90                                                                                         
		29 01 00 00 00 00 10 CC 00 00 00 00 00 00 00 00 00 00 00 00 00 00 00     
		29 01 00 00 00 00 02 00 A0                                                                                         
		29 01 00 00 00 00 0C CC 00 03 01 0D 0F 09 0B 22 21 25 26                             
		29 01 00 00 00 00 02 00 B0                                                                                         
		29 01 00 00 00 00 0B CC 25 26 21 22 10 0A 0C 0E 04 02                                   
		29 01 00 00 00 00 02 00 C0                                                                                         
		29 01 00 00 00 00 07 CC 00 00 00 00 00 00                                                           
		29 01 00 00 00 00 02 00 CA                                                                                         
		29 01 00 00 00 00 06 CC 00 00 00 00 00                                                                 
		29 01 00 00 00 00 02 00 D0                                                                                         
		29 01 00 00 00 00 0C CC 00 01 03 0D 0B 09 0F 22 21 26 25                             
		29 01 00 00 00 00 02 00 00                                                                                         
		29 01 00 00 00 00 0B E1 00 0C 1E 2B 3B 49 4B 75 64 7E                                   
		29 01 00 00 00 00 0B E1 85 6E 7E 56 52 42 30 23 15 00                                   
		29 01 00 00 00 00 02 00 00                                                                                         
		29 01 00 00 00 00 0B E2 00 0C 1E 2B 3C 49 4B 75 65 7E                                   
		29 01 00 00 00 00 0B E2 85 6F 7E 56 52 42 30 23 15 00                                   
		29 01 00 00 00 00 02 00 80                                                                                         
		29 01 00 00 00 00 02 C4 30                                                                                         
		29 01 00 00 00 00 02 00 98                                                                                         
		29 01 00 00 00 00 02 C0 00                                                                                         
		29 01 00 00 00 00 02 00 a9                                                                                         
		29 01 00 00 00 00 02 C0 0A                                                                                         
		29 01 00 00 00 00 02 00 b0                                                                                         
		29 01 00 00 00 00 04 C1 20 00 00                                                                             
		29 01 00 00 00 00 02 00 e1                                                                                         
		29 01 00 00 00 00 03 C0 40 30                                                                                   
		29 01 00 00 00 00 02 00 80                                                                                         
		29 01 00 00 00 00 03 C1 03 33                                                                                   
		29 01 00 00 00 00 02 00 A0                                                                                         
		29 01 00 00 00 00 02 C1 e8                                                                                         
		29 01 00 00 00 00 02 00 90                                                                                         
		29 01 00 00 00 00 02 b6 b4                                                                                         
		29 01 00 00 00 00 02 00 00           
		29 01 00 00 00 00 02 fb 01           
		29 01 00 00 00 00 02 00 00           
		29 01 00 00 00 00 04 FF FF FF FF
		29 01 00 00 78 00 02 11 00                  
		29 01 00 00 32 00 02 29 00];
		qcom,mdss-dsi-off-command = [05 01 00 00 32 00 02 28 00
					05 01 00 00 78 00 02 10 00];
		qcom,mdss-dsi-on-command-state = "dsi_lp_mode";
		qcom,mdss-dsi-off-command-state = "dsi_lp_mode";
		qcom,mdss-dsi-h-sync-pulse = <1>;
		qcom,mdss-dsi-traffic-mode = "burst_mode";
		qcom,mdss-dsi-lane-map = "lane_map_0123";
		qcom,mdss-dsi-bllp-eof-power-mode;
		qcom,mdss-dsi-bllp-power-mode;
		qcom,mdss-dsi-lane-0-state;
		qcom,mdss-dsi-lane-1-state;
		qcom,mdss-dsi-panel-timings = [b8 0c 08 00 2a 2c 10 12 08 03 04 00];
		qcom,mdss-dsi-t-clk-post = <0x1e>;
		qcom,mdss-dsi-t-clk-pre = <0x38>;  
		qcom,mdss-dsi-bl-min-level = <1>;
		qcom,mdss-dsi-bl-max-level = <4095>;
		qcom,mdss-dsi-dma-trigger = "trigger_sw";
		qcom,mdss-dsi-mdp-trigger = "none"; 
		qcom,mdss-dsi-bl-pmic-control-type = "bl_ctrl_pwm";
		qcom,mdss-dsi-reset-sequence = <1 20>, <0 20>, <1 120>;
	};
};
