/**********uniscope-driver-modify-file-on-qualcomm-platform*****************/
/* Copyright (c) 2013, The Linux Foundation. All rights reserved.
 *
 * This program is free software; you can redistribute it and/or modify
 * it under the terms of the GNU General Public License version 2 and
 * only version 2 as published by the Free Software Foundation.
 *
 * This program is distributed in the hope that it will be useful,
 * but WITHOUT ANY WARRANTY; without even the implied warranty of
 * MERCHANTABILITY or FITNESS FOR A PARTICULAR PURPOSE.  See the
 * GNU General Public License for more details.
 */

/*---------------------------------------------------------------------------
 * This file is autogenerated file using gcdb parser. Please do not edit it.
 * Update input XML file to add a new entry or update variable in this file
 * VERSION = "1.0"
 *---------------------------------------------------------------------------*/
/*---------------------------------------------------------------------------
 * 
 * 
 * JZZ(zhizhang)@uniscope_drv 20140620 for adjusting hx8389b_qhd lcd
 *---------------------------------------------------------------------------*/
&mdss_mdp {
	dsi_hx8389b_qhd_vid: qcom,mdss_dsi_hx8389b_qhd_video {
		qcom,mdss-dsi-panel-name = "hx8389b qhd video mode dsi panel";
		qcom,mdss-dsi-panel-controller = <&mdss_dsi0>;
		qcom,mdss-dsi-panel-type = "dsi_video_mode";
		qcom,mdss-dsi-panel-destination = "display_1";
		qcom,mdss-dsi-panel-framerate = <60>;
		qcom,mdss-dsi-virtual-channel-id = <0>;
		qcom,mdss-dsi-stream = <0>;
		qcom,mdss-dsi-panel-width = <540>;
		qcom,mdss-dsi-panel-height = <960>;
		qcom,mdss-dsi-h-front-porch = <60>;
		qcom,mdss-dsi-h-back-porch = <60>;
		qcom,mdss-dsi-h-pulse-width = <30>;
		qcom,mdss-dsi-h-sync-skew = <0>;
		qcom,mdss-dsi-v-back-porch = <15>;
		qcom,mdss-dsi-v-front-porch = <20>;
		qcom,mdss-dsi-v-pulse-width = <2>;
		qcom,mdss-dsi-h-left-border = <0>;
		qcom,mdss-dsi-h-right-border = <0>;
		qcom,mdss-dsi-v-top-border = <0>;
		qcom,mdss-dsi-v-bottom-border = <0>;
		qcom,mdss-dsi-bpp = <24>;
		qcom,mdss-dsi-color-order = "rgb_swap_rgb";
		qcom,mdss-dsi-underflow-color = <0xff>;
		qcom,mdss-dsi-border-color = <0>;
		qcom,mdss-dsi-on-command = [
			    39 01 00 00 00 00 04
			       	B9 FF 83 89
				39 01 00 00 01 00 08 
					BA 41 93 00 16 A4 10 18
				39 01 00 00 01 00 14 
					B1 00 00 07 F6 59 10 11 
					F8 F7 24 2C 3F 3F 42 01 
					38 F7 00 E6
				39 01 00 00 01 00 08 
					B2 00 00 78 0D 12 3F C0
				39 01 00 00 01 00 20
					B4 80 0C 00 32 10 05 54 
					13 D3 32 10 00 47 35 36 
					07 47 35 36 0B 40 40 0B 
					00 40 00 40 14 46 50 0A
				39 01 00 00 01 00 03
					C7 10 10 
				39 01 00 00 01 00 33
					D5 00 00 00 00 01 00 00 
					00 3C 08 88 88 01 01 23
					45 67 AA BB 45 88 88 67 
					88 88 88 88 88 88 88 88
					54 32 10 76 54 AA BB 10 
					88 88 76 88 88 88 88 88 
					88 00 03
				39 01 00 00 01 00 23 
					E0 04 0E 11 2B 2E 3F 19 
					37 05 0C 0E 12 14 12 13
					12 1A 04 0E 11 2B 2E 3F
					19 37 05 0C 0E 12 14 12
					13 12 1A
				39 01 00 00 00 00 05 
					B6 00 91 00 91
				39 01 00 00 00 00 04
					B7 00 00 57
				23 01 00 00 01 00 02 
					CC 02
				05 01 00 00 7F 00 02
					11 00
				39 01 00 00 00 00 05
					DE 05 58 12 02
				05 01 00 00 14 00 02
					29 00
				];
		qcom,mdss-dsi-off-command = [05 01 00 00 32 00 02 28 00
					05 01 00 00 78 00 02 10 00];
		qcom,mdss-dsi-on-command-state = "dsi_lp_mode";
		qcom,mdss-dsi-off-command-state = "dsi_lp_mode";
		qcom,mdss-dsi-h-sync-pulse = <1>;
		qcom,mdss-dsi-traffic-mode = "burst_mode";
		qcom,mdss-dsi-lane-map = <0>;
		qcom,mdss-dsi-bllp-eof-power-mode;
		qcom,mdss-dsi-bllp-power-mode;
		qcom,mdss-dsi-lane-0-state;
		qcom,mdss-dsi-lane-1-state;
		qcom,mdss-dsi-panel-timings = [8b 1e 14 00 44 48 18 22 19 03 04 00];
		qcom,mdss-dsi-t-clk-post = <0x1e>;
		qcom,mdss-dsi-t-clk-pre = <0x38>;
		qcom,mdss-dsi-bl-min-level = <1>;
		qcom,mdss-dsi-bl-max-level = <4095>;
		qcom,mdss-dsi-dma-trigger = "trigger_sw";
		qcom,mdss-dsi-mdp-trigger = "none";
		qcom,mdss-dsi-bl-pmic-control-type = "bl_ctrl_pwm"; 
		qcom,mdss-dsi-reset-sequence = <1 20>, <0 2>, <1 20>;
	};
};
