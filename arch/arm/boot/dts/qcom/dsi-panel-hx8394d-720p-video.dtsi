/**********uniscope-driver-modify-file-on-qualcomm-platform*****************/
/* Copyright (c) 2013, The Linux Foundation. All rights reserved.
 *
 * This program is free software; you can redistribute it and/or modify
 * it under the terms of the GNU General Public License version 2 and
 * only version 2 as published by the Free Software Foundation.
 *
 * This program is distributed in the hope that it will be useful,
 * but WITHOUT ANY WARRANTY; without even the implied warranty of
 * MERCHANTABILITY or FITNESS FOR A PARTICULAR PURPOSE.  See the
 * GNU General Public License for more details.
 */

/*---------------------------------------------------------------------------
 * This file is autogenerated file using gcdb parser. Please do not edit it.
 * Update input XML file to add a new entry or update variable in this file
 * VERSION = "1.0"
 *---------------------------------------------------------------------------*/
/*---------------------------------------------------------------------------
 * 
 * 
 * JZZ(zhizhang)@uniscope_drv 20140623 for adjusting hx8394d_720p lcd
 *---------------------------------------------------------------------------*/
&mdss_mdp {
	dsi_hx8394d_720p_vid: qcom,mdss_dsi_hx8394d_720p_video {
		qcom,mdss-dsi-panel-name = "hx8394d 720p video mode dsi panel";
		qcom,mdss-dsi-panel-controller = <&mdss_dsi0>;
		qcom,mdss-dsi-panel-type = "dsi_video_mode";
		qcom,mdss-dsi-panel-destination = "display_1";
		qcom,mdss-dsi-panel-framerate = <60>;
		qcom,mdss-dsi-virtual-channel-id = <0>;
		qcom,mdss-dsi-stream = <0>;
		qcom,mdss-dsi-panel-width = <720>;
		qcom,mdss-dsi-panel-height = <1280>;
/*liguowei@uniscope.com 20141218 modify LCD mipi bitclock 420MHz to 418MHz to avoid RF disturbance begin*/
		qcom,mdss-dsi-h-front-porch = <70>;
		qcom,mdss-dsi-h-back-porch = <70>; 
		qcom,mdss-dsi-h-pulse-width = <26>;
/*liguowei@uniscope.com 20141218 modify LCD mipi bitclock 420MHz to 418MHz to avoid RF disturbance end*/ 
		qcom,mdss-dsi-h-sync-skew = <0>;
		qcom,mdss-dsi-v-back-porch = <12>;/*liguowei@uniscope.com 20140901*/
		qcom,mdss-dsi-v-front-porch = <15>;/*liguowei@uniscope.com 20140901*/
		qcom,mdss-dsi-v-pulse-width = <4>;/*liguowei@uniscope.com 20140901*/
		qcom,mdss-dsi-h-left-border = <0>;
		qcom,mdss-dsi-h-right-border = <0>;
		qcom,mdss-dsi-v-top-border = <0>;
		qcom,mdss-dsi-v-bottom-border = <0>;
		qcom,mdss-dsi-bpp = <24>;
		qcom,mdss-dsi-color-order = "rgb_swap_rgb";
		qcom,mdss-dsi-underflow-color = <0xff>;
		qcom,mdss-dsi-border-color = <0>;
		
		qcom,mdss-dsi-on-command = [
			39 01 00 00 00 00 04
			       	B9 FF 83 94
			39 01 00 00 00 00 0c  /*liguowei@uniscope 20141031 lcd flicker when system first bootup*/
                                     BA 73 43 20
                                     65 B2 09 09
                                     40 10 00 00

			39 01 00 00 00 00 10
                                     B1 7C 12 12
				16 04 11 F1 
                                     81 7C 99 23 
				80 C0 D2 58
			39 01 00 00 00 00 0d 
				B4 00 FF 51
				5A 59 5A 03
                                     5A 01 70 01 
                                     70

			39 01 00 00 00 00 0c
				B2 00 64 0E
				0D 22 1C 08 
				08 1C 4D 00
			39 01 00 00 00 00 02
				bc 07
			39 01 00 00 00 00 04
				Bf  41  0e  01

                            39 01 00 00 00 00 26 
				D3 00 0F 00 
				40 07 10 00
				08 10 08 00
				08 54 15 0E
				05 0E 02 15
				06 05 06 47
				44 0A 0A 4B
                                     10 07 07 08
                                     00 00 00 0A
                                     00 01


			39 01 00 00 00 00 2d
				D5 1A 1A 1B
				1B 00 01 02
				03 04 05 06
				07 08 09 0A
				0B 24 25 18
				18 26 27 18
				18 18 18 18
				18 18 18 18
				18 18 18 18
				18 18 18 20
				21 18 18 18
				18
			39 01 00 00 00 00 2d 
				D6 1A 1A 1B
				1B 0B 0A 09
				08 07 06 05
				04 03 02 01
				00 21 20 58
				58 27 26 18
				18 18 18 18
				18 18 18 18
				18 18 18 18
				18 18 18 25
				24 18 18 18
				18
			39 01 00 00 00 00 2b 
				E0 00 15 1a 
				30 34 3F 26 
				3F 06 0b 0D 
				17 0e 11 13 
				11 13 07 12 
				14 18 00 15 
				1a 30 34 3F 
				25 3F 06 0b 
				0D 17 0e 11 
				13 11 13 07 
				12 14 18
			39 01 00 00 00 00 02 
			        BD 00 
			39 01 00 00 00 00 2C 	//R
			        C1 01 00 08 
                                0F 17 1F 27 
                                2F 37 3F 47 
                                4F 56 5E 66 
                                6E 76 7E 86 
                                8E 96 9E A6 
                                AD B5 BD C5 
                                CD D5 DD E5 
                                ED F5 FC B7 
                                5A C0 AF 15 
                                F0 01 05 00 
			39 01 00 00 00 00 02 
			        BD 01 
                        39 01 00 00 00 00 2B //G
                                C1 00 07 10 
			        17 20 28 2F 
                                38 3F 47 4F 
                                57 5F 68 6F 
                                77 7F 88 8F 
                                98 9F A7 B0 
                                B8 BF C8 CF 
                                D7 E0 E8 F0 
                                F7 FF CC 30 
                                FF F3 33 0F 
                                03 C0 00  
			39 01 00 00 00 00 02 
			        BD 02 	
                        39 01 00 00 00 00 2B  //B
			        C1 00 09 0E 
			        15 1D 24 2C 
			        33 3B 42 4A 
			        51 58 60 67 
			        6F 76 7D 85 
			        8C 94 9B A2 
			        AA B1 B9 C0 
			        C7 CF D6 DE 
			        E5 EC D3 CC 
			        49 23 9E 74  
			        03 89 00 
			39 01 00 00 00 00 02 
				CC 09
			39 01 00 00 00 00 05
				C7 00 C0 40
				C0 
			39 01 00 00 00 00 03 
				B6 74 74 
			39 01 00 00 00 00 03 
				C0 30  14 	
			05 01 00 00 C8 00 02
				11 00
			05 01 00 00 14 00 02
				29 00
				];
		
		qcom,mdss-dsi-off-command = [05 01 00 00 32 00 02 28 00
					05 01 00 00 78 00 02 10 00];
		qcom,mdss-dsi-on-command-state = "dsi_lp_mode";
		qcom,mdss-dsi-off-command-state = "dsi_lp_mode";
                /*liguowei@uniscope 20140924 add hx8394d esd check , remove */
		//qcom,mdss-dsi-panel-status-command = [06 01 00 01 05 00 02 09 08];
		//qcom,mdss-dsi-panel-status-command-state = "dsi_lp_mode";
		//qcom,mdss-dsi-panel-status-check-mode = "reg_read";
		//qcom,mdss-dsi-panel-status-value = <0x80730400>;
                /* liguowei@uniscope 20140924 add hx8394d esd check , remove */
		qcom,mdss-dsi-h-sync-pulse = <1>;
		qcom,mdss-dsi-traffic-mode = "burst_mode";
		qcom,mdss-dsi-lane-map = <0>;
		qcom,mdss-dsi-bllp-eof-power-mode;
		qcom,mdss-dsi-bllp-power-mode;
		qcom,mdss-dsi-lane-0-state;
		qcom,mdss-dsi-lane-1-state;
		qcom,mdss-dsi-lane-2-state;
		qcom,mdss-dsi-lane-3-state;		
		qcom,mdss-dsi-panel-timings = [BB 1A 10 00 3E 40 16 1E 15 03 04 00];/*liguowei@uniscope.com 20141218 modify LCD mipi bitclock 420MHz to 418MHz to avoid GPS disturbance*/
		qcom,mdss-dsi-t-clk-post = <0x1e>;
		qcom,mdss-dsi-t-clk-pre = <0x38>;
		qcom,mdss-dsi-bl-min-level = <1>;
		qcom,mdss-dsi-bl-max-level = <4095>;
		qcom,mdss-dsi-dma-trigger = "trigger_sw";
		qcom,mdss-dsi-mdp-trigger = "none";
		qcom,mdss-dsi-bl-pmic-control-type = "bl_ctrl_pwm"; 

		qcom,mdss-dsi-reset-sequence = <1 20>, <0 2>, <1 200>;
	};
};
